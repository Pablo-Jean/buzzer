# file: Buzzer-STM32F411.ioc
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Mcu.Family=STM32F4
Mcu.Name=STM32F411C(C-E)Ux
Mcu.Package=UFQFPN48
NVIC.PriorityGroup=NVIC_PRIORITYGROUP_4
NVIC.TIM1_BRK_TIM9_IRQn=true\:0\:0\:false\:false\:true\:true\:true\:true
PA13.Mode=Serial_Wire
PA13.Signal=SYS_JTMS-SWDIO
PA14.Mode=Serial_Wire
PA14.Signal=SYS_JTCK-SWCLK
PB4.Signal=S_TIM3_CH1
ProjectManager.HeapSize=0x200
ProjectManager.StackSize=0x400
ProjectManager.TargetToolchain=STM32CubeIDE
RCC.48MHZClocksFreq_Value=50000000
RCC.AHBFreq_Value=100000000
RCC.APB1CLKDivider=RCC_HCLK_DIV2
RCC.APB1Freq_Value=50000000
RCC.APB1TimFreq_Value=100000000
RCC.APB2Freq_Value=100000000
RCC.APB2TimFreq_Value=100000000
RCC.CortexFreq_Value=100000000
RCC.HCLKFreq_Value=100000000
RCC.HSE_VALUE=25000000
RCC.HSI_VALUE=16000000
RCC.LSE_VALUE=32768
RCC.PLLM=8
RCC.PLLN=100
RCC.SYSCLKFreq_VALUE=100000000
RCC.SYSCLKSource=RCC_SYSCLKSOURCE_PLLCLK
RCC.VCOOutputFreq_Value=200000000
SH.S_TIM3_CH1.0=TIM3_CH1,PWM Generation1 CH1
TIM3.Channel-PWM\ Generation1\ CH1=TIM_CHANNEL_1
TIM3.Period=2000
TIM3.Prescaler=100
TIM9.Period=999
TIM9.Prescaler=999
VP_TIM3_VS_ClockSourceINT.Mode=Internal
VP_TIM9_VS_ClockSourceINT.Mode=Internal
board=custom

// file: Core/Src/main.c
/* USER CODE BEGIN Header */
/**
  ******************************************************************************
  * @file           : main.c
  * @brief          : Main program body
  ******************************************************************************
  * @attention
  *
  * Copyright (c) 2022 STMicroelectronics.
  * All rights reserved.
  *
  * This software is licensed under terms that can be found in the LICENSE file
  * in the root directory of this software component.
  * If no LICENSE file comes with this software, it is provided AS-IS.
  *
  ******************************************************************************
  */
/* USER CODE END Header */
#include "main.h"
#include "tim.h"
#include "gpio.h"

/* USER CODE BEGIN Includes */
#include <malloc.h>

#include "buzzer.h"
/* USER CODE END Includes */

/* USER CODE BEGIN PTD */
typedef enum{
	EXAMPLE_BUZZER_START,
	EXAMPLE_BUZZER_STOP,
	EXAMPLE_BUZZER_RINGTONE,
	EXAMPLE_BUZZER_NO_LOOP,
	EXAMPLE_BUZZER_LOOP
}example_buzzer_e;
/* USER CODE END PTD */

/* USER CODE BEGIN PD */

// if you want to use static memry allocation,
// uncomment below
//#define USE_STATIC_MEM_ALLOCATION

/* USER CODE END PD */

/* USER CODE BEGIN PM */

#define PWM_TIM		&htim3
#define PWM_CHN		TIM_CHANNEL_1

/* USER CODE END PM */

/* USER CODE BEGIN PV */

#ifndef USE_STATIC_MEM_ALLOCATION
buzzer_t mBuzzer;
#endif

buzzer_t *Buzzer;
example_buzzer_e example = EXAMPLE_BUZZER_START;
uint8_t nextPattern;

/* USER CODE END PV */

void SystemClock_Config(void);

/* USER CODE BEGIN 0 */

/**
 * Start PWM
 */

void pwm_start(){
	HAL_TIM_PWM_Start(PWM_TIM, PWM_CHN);
}

/**
 * Set the Duty Cycle of the PWM
 */
void pwm_set_dc(uint32_t dc){
	uint32_t arr, comp;

	arr = __HAL_TIM_GET_AUTORELOAD(PWM_TIM);
	comp = dc*arr/100;
	__HAL_TIM_SET_COMPARE(PWM_TIM, PWM_CHN, comp);
}

/**
 * Set the Frequency of the PWM
 */
void pwm_set_freq(uint32_t freq){
	uint32_t psc, arr, sys;

	if (freq > 0){
		sys = HAL_RCC_GetSysClockFreq();
		arr = __HAL_TIM_GET_AUTORELOAD(PWM_TIM);
		psc = (sys/(freq*(arr+1)))-1;
		__HAL_TIM_SET_PRESCALER(PWM_TIM, psc);
		pwm_set_dc(50);
	}
	else
		__HAL_TIM_SET_COMPARE(PWM_TIM, PWM_CHN, 0);
}

/**
 * Timer Callback
 */
void HAL_TIM_PeriodElapsedCallback(TIM_HandleTypeDef *htim){
	if (htim->Instance == TIM9){
		buzzer_interrupt(Buzzer);
	}
}

/**
 * Callback from buzzer
 */

void buzzer_end_callback(buzzer_t *buzzer){
	nextPattern = 1;
}

/* USER CODE END 0 */

int main(void)
{
  /* USER CODE BEGIN 1 */
#ifdef USE_STATIC_MEM_ALLOCATION
	Buzzer = malloc(sizeof(buzzer_t));
#else
	Buzzer = &mBuzzer;
#endif
  /* USER CODE END 1 */

  /* MCU Configuration--------------------------------------------------------*/

  /* Reset of all peripherals, Initializes the Flash interface and the Systick. */
  HAL_Init();

  /* Configure the system clock */
  SystemClock_Config();

  /* Initialize all configured peripherals */
  MX_GPIO_Init();
  MX_TIM3_Init();
  MX_TIM9_Init();
  /* USER CODE BEGIN 2 */

  // Configure the Buzzer object
  Buzzer->interruptMs = 10; // interrupt will be triggered every 10ms
  Buzzer->fnx.pwmOut = pwm_set_freq; // pass set frequency function

  // initialize Buzzer
  buzzer_init(Buzzer);

  HAL_TIM_Base_Start_IT(&htim9);
  pwm_start();

  nextPattern = 1;
  /* USER CODE END 2 */

  /* Infinite loop */
  /* USER CODE BEGIN WHILE */
  while (1)
  {
	  if (nextPattern){
		  nextPattern = 0;
		  HAL_Delay(500);
		  switch (example){
		  case EXAMPLE_BUZZER_START:
			  buzzer_turn_on(Buzzer, 1500);
			  nextPattern = 1;
			  break;
		  case EXAMPLE_BUZZER_STOP:
			  buzzer_stop(Buzzer);
			  nextPattern = 1;
			  break;
		  case EXAMPLE_BUZZER_RINGTONE:
			  buzzer_start_array(Buzzer, mario_theme_time, mario_theme_melody, mario_theme_len);
			  break;
		  case EXAMPLE_BUZZER_NO_LOOP:
			  buzzer_start(Buzzer, 500, 750, BUZZER_LOOP_OFF);
			  break;
		  case EXAMPLE_BUZZER_LOOP:
			  buzzer_start(Buzzer, 800, 250, BUZZER_LOOP_ON);
			  break;
		  }
		  example++;
	  }
    /* USER CODE END WHILE */

  }
}

void SystemClock_Config(void)
{
  RCC_OscInitTypeDef RCC_OscInitStruct = {0};
  RCC_ClkInitTypeDef RCC_ClkInitStruct = {0};

  /** Configure the main internal regulator output voltage
  */
  __HAL_RCC_PWR_CLK_ENABLE();
  __HAL_PWR_VOLTAGESCALING_CONFIG(PWR_REGULATOR_VOLTAGE_SCALE1);

  /** Initializes the RCC Oscillators according to the specified parameters
  * in the RCC_OscInitTypeDef structure.
  */
  RCC_OscInitStruct.OscillatorType = RCC_OSCILLATORTYPE_HSI;
  RCC_OscInitStruct.HSIState = RCC_HSI_ON;
  RCC_OscInitStruct.HSICalibrationValue = RCC_HSICALIBRATION_DEFAULT;
  RCC_OscInitStruct.PLL.PLLState = RCC_PLL_ON;
  RCC_OscInitStruct.PLL.PLLSource = RCC_PLLSOURCE_HSI;
  RCC_OscInitStruct.PLL.PLLM = 8;
  RCC_OscInitStruct.PLL.PLLN = 100;
  RCC_OscInitStruct.PLL.PLLP = RCC_PLLP_DIV2;
  RCC_OscInitStruct.PLL.PLLQ = 4;
  if (HAL_RCC_OscConfig(&RCC_OscInitStruct) != HAL_OK)
  {
    Error_Handler();
  }

  /** Initializes the CPU, AHB and APB buses clocks
  */
  RCC_ClkInitStruct.ClockType = RCC_CLOCKTYPE_HCLK|RCC_CLOCKTYPE_SYSCLK
                              |RCC_CLOCKTYPE_PCLK1|RCC_CLOCKTYPE_PCLK2;
  RCC_ClkInitStruct.SYSCLKSource = RCC_SYSCLKSOURCE_PLLCLK;
  RCC_ClkInitStruct.AHBCLKDivider = RCC_SYSCLK_DIV1;
  RCC_ClkInitStruct.APB1CLKDivider = RCC_HCLK_DIV2;
  RCC_ClkInitStruct.APB2CLKDivider = RCC_HCLK_DIV1;

  if (HAL_RCC_ClockConfig(&RCC_ClkInitStruct, FLASH_LATENCY_3) != HAL_OK)
  {
    Error_Handler();
  }
}

void Error_Handler(void)
{
  __disable_irq();
  while (1)
  {
  }
}
